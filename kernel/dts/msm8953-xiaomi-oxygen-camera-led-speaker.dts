// SPDX-License-Identifier: BSD-3-Clause
/* Mi Max 2 (oxygen): cameras + rear LED torch + bottom loudspeaker. */
#include "msm8953-xiaomi-oxygen-camera-led.dts"
#include "msm8953-xiaomi-oxygen-speaker.dtsi"
